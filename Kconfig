## Kconfig
```kconfig
#
# For a description of the syntax of this configuration file,
# see the file kconfig-language.txt in the NuttX tools repository.
#

config EXTERNAL_SQLITE
	bool "sqlite3 library"
	default n
	---help---
		Enables the sqlite3 library.
```
